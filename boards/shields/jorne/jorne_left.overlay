/*
 * Copyright (c) 2020 The ZMK Contributors
 *
 * SPDX-License-Identifier: MIT
 */

#include "jorne.dtsi"


// &pinctrl {
//     spi1_default: spi1_default {
//         group1 {
//             psels = <NRF_PSEL(SPIM_SCK, 0, 1)>,
//                 <NRF_PSEL(SPIM_MOSI, 0, 0)>,
//                 <NRF_PSEL(SPIM_MISO, 0, 5)>;
//         };
//     };

//      spi1_sleep: spi1_sleep {
//         group1 {
//             psels = <NRF_PSEL(SPIM_SCK, 0, 1)>,
//                 <NRF_PSEL(SPIM_MOSI, 0, 0)>,
//                 <NRF_PSEL(SPIM_MISO, 0, 5)>;
//             low-power-enable;
//         };
//     };
// };

// nice_view_spi: &spi0 {
//    status = "okay";
//    compatible = "nordic,nrf-spim";
//    pinctrl-0 = <&spi1_default>;
//    pinctrl-1 = <&spi1_sleep>;
//    pinctrl-names = "default", "sleep";
//    cs-gpios = <&gpio1 4 GPIO_ACTIVE_HIGH>;
// };

&glidepoint_listener {
    status = "okay";
};
