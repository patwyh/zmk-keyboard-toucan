/*
 * Copyright (c) 2020 The ZMK Contributors
 *
 * SPDX-License-Identifier: MIT
 */

#include "jorne.dtsi"

&jorne_transform {
    col-offset = <6>;
};

&crkbd_transform {
    col-offset = <6>;
};

&five_column_transform {
    col-offset = <6>;
};


&pinctrl {
    spi0_default: spi0_default {
        group1 {
            psels = <NRF_PSEL(SPIM_SCK, 0, 12)>,
                <NRF_PSEL(SPIM_MOSI, 0, 26)>,
                <NRF_PSEL(SPIM_MISO, 0, 5)>;
        };
    };

    spi0_sleep: spi0_sleep {
        group1 {
            psels = <NRF_PSEL(SPIM_SCK, 0, 12)>,
                <NRF_PSEL(SPIM_MOSI, 0, 26)>,
                <NRF_PSEL(SPIM_MISO, 0, 5)>;
            low-power-enable;
            bias-pull-down; 
        };
    };

    spi1_default: spi1_default {
        group1 {
            psels = <NRF_PSEL(SPIM_SCK, 0, 1)>,
                <NRF_PSEL(SPIM_MOSI, 0, 0)>,
                <NRF_PSEL(SPIM_MISO, 0, 0)>;
        };
    };

     spi1_sleep: spi1_sleep {
        group1 {
            psels = <NRF_PSEL(SPIM_SCK, 0, 1)>,
                <NRF_PSEL(SPIM_MOSI, 0, 0)>,
                <NRF_PSEL(SPIM_MISO, 0, 0)>;
            low-power-enable;
        };
    };
};


nice_view_spi: &spi1 {
    status = "okay";
    compatible = "nordic,nrf-spim";
    pinctrl-0 = <&spi1_default>;
    pinctrl-1 = <&spi1_sleep>;
    pinctrl-names = "default", "sleep";
    cs-gpios = <&gpio1 4 GPIO_ACTIVE_HIGH>, // nice view
};

&spi0 {
   compatible = "nordic,nrf-spim";
   status = "okay";
   pinctrl-0 = <&spi0_default>;
   pinctrl-1 = <&spi0_sleep>;
   pinctrl-names = "default", "sleep";
   cs-gpios = <&gpio1 2 (GPIO_ACTIVE_LOW | GPIO_PULL_UP)>;  // pull-up to ensure CS is !asserted when asleep
   glidepoint:  glidepoint@0 {
        compatible = "cirque,pinnacle";
        reg = <0>;
        spi-max-frequency = <1000000>;
        status = "okay";
        dr-gpios = <&gpio0 7 (GPIO_ACTIVE_HIGH)>;
        sensitivity = "2x";
        x-invert;

        // Optional: turning this on enables very aggressive power saving, after 5 seconds with no touches
        // the trackpad will go to sleep.  It wakes up on touch, but there is a ~300ms delay.  Most users will find
        // the standard behavior of 'put to sleep when zmk enters idle state (30 seconds without a keypress) feels better.
	    //sleep;
    };
};


&glidepoint_listener {
    status = "okay";
};

