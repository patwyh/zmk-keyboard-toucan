## boards/arm/eknrf/Kconfig.board
```kconfig
# Puchi-BLE board configuration

# Copyright (c) 2022 The ZMK Contributors
# SPDX-License-Identifier: MIT

config BOARD_EKNRF
    bool "eknrf"
    depends on SOC_NRF52840_QIAA
```

## boards/shields/ek_adapter/Kconfig.shield
```kconfig
# Copyright (c) 2022 The ZMK Contributors
# SPDX-License-Identifier: MIT

config SHIELD_EK_ADAPTER
    def_bool $(shields_list_contains,ek_adapter)
```

## boards/shields/jorne/Kconfig.defconfig
```kconfig
if SHIELD_JORNE_LEFT

config ZMK_KEYBOARD_NAME
    default "Ek"

config ZMK_SPLIT_ROLE_CENTRAL
    default y
endif

if SHIELD_JORNE_LEFT || SHIELD_JORNE_RIGHT

config SPI
    default y

config ZMK_SPLIT
    default y

config ZMK_POINTING
    default y

endif
```
